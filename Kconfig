## Kconfig
```kconfig
menu "ISP3x80 Demo"
rsource "src/modules/Kconfig"
rsource "src/events/Kconfig"
endmenu

menu "Zephyr Kernel"
source "Kconfig.zephyr"
endmenu

config ISP_VERSION
  string "version"
  default "$(VERSION_MAJOR).$(VERSION_MINOR).$(PATCHLEVEL)"
```

## boards/insightsip/isp3080_ux/Kconfig.defconfig
```kconfig
if BOARD_ISP3080_UX_TG_NRF52833 || BOARD_ISP3080_UX_AN_NRF52833

config BT_CTLR
	default BT

endif #BOARD_ISP3080_UX_TG_NRF52833 || BOARD_ISP3080_UX_AN_NRF52833
```

## boards/insightsip/isp3080_ux/board.yml
```yaml
boards:
  - name: isp3080_ux_tg
    vendor: insightsip
    socs:
      - name: nrf52833
  - name: isp3080_ux_an
    vendor: insightsip
    socs:
      - name: nrf52833
```

## boards/insightsip/isp3080_ux/isp3080_ux_an_defconfig
```kconfig
CONFIG_ARM_MPU=y
CONFIG_HW_STACK_PROTECTION=y

CONFIG_USE_SEGGER_RTT=y
CONFIG_SPI=y
CONFIG_GPIO=y
CONFIG_LED=n
CONFIG_LED_GPIO=n
CONFIG_I2C=y
CONFIG_SERIAL=y
CONFIG_SENSOR=n
CONFIG_LIS2DE12=n
CONFIG_LIS2DE12_TRIGGER_OWN_THREAD=n
```

## boards/insightsip/isp3080_ux/isp3080_ux_tg_defconfig
```kconfig
CONFIG_ARM_MPU=n
CONFIG_HW_STACK_PROTECTION=n

CONFIG_USE_SEGGER_RTT=y
CONFIG_SPI=y
CONFIG_GPIO=y
CONFIG_LED=y
CONFIG_LED_GPIO=y
CONFIG_I2C=y
CONFIG_SENSOR=n
CONFIG_LIS2DE12=n
CONFIG_LIS2DE12_TRIGGER_OWN_THREAD=n
CONFIG_REGULATOR=y
```

## boards/insightsip/isp3580_ux/Kconfig.isp3580_ux_an
```kconfig
config BOARD_ISP3580_UX_AN
	select SOC_NRF54L15_CPUAPP if BOARD_ISP3580_UX_AN_NRF54L15_CPUAPP
	select SOC_NRF54L15_CPUFLPR if \
		BOARD_ISP3580_UX_AN_NRF54L15_CPUFLPR || \
		BOARD_ISP3580_UX_AN_NRF54L15_CPUFLPR_XIP
```

## boards/insightsip/isp3580_ux/Kconfig.isp3580_ux_tg
```kconfig
config BOARD_ISP3580_UX_TG
	select SOC_NRF54L15_CPUAPP if BOARD_ISP3580_UX_TG_NRF54L15_CPUAPP
	select SOC_NRF54L15_CPUFLPR if \
		BOARD_ISP3580_UX_TG_NRF54L15_CPUFLPR || \
		BOARD_ISP3580_UX_TG_NRF54L15_CPUFLPR_XIP
```

## boards/insightsip/isp3580_ux/board.yml
```yaml
boards:
  - name: isp3580_ux_tg
    vendor: insightsip
    socs:
    - name: nrf54l15
      variants:
      - name: xip
        cpucluster: 
  - name: isp3580_ux_an
    vendor: insightsip
    socs:
    - name: nrf54l15
      variants:
      - name: xip
        cpucluster: cpuflpr
```

## boards/insightsip/isp3580_ux/isp3580_ux_tg_nrf54l15_cpuapp_defconfig
```kconfig
CONFIG_ARM_MPU=y
CONFIG_HW_STACK_PROTECTION=y

CONFIG_NULL_POINTER_EXCEPTION_DETECTION_NONE=y

CONFIG_CACHE_MANAGEMENT=y
CONFIG_EXTERNAL_CACHE=y

CONFIG_NRF_GRTC_START_SYSCOUNTER=y

CONFIG_USE_SEGGER_RTT=y
CONFIG_SPI=y
CONFIG_GPIO=y
CONFIG_LED=y
CONFIG_I2C=y
CONFIG_SENSOR=y
CONFIG_LIS2DE12=y
CONFIG_LIS2DE12_TRIGGER_OWN_THREAD=y
CONFIG_REGULATOR=y
```

## src/events/Kconfig
```kconfig
#
# Copyright (c) 2019 Nordic Semiconductor
#
# SPDX-License-Identifier: LicenseRef-Nordic-5-Clause
#

if LOG

menu "Event options"

comment "Logged events"

config ISP_LOG_TWR_RANGE_EVENT
	bool "Log twr range events"
	default y
	help
	  Log twr range events.
	  
config ISP_LOG_TWR_ERROR_EVENT
	bool "Log twr error events"
	default y
	help
	  Log twr error events.	  

config ISP_LOG_BATTERY_STATE_EVENT
	bool "Log battery state events"
	default y
	help
	  Log battery state events.

config ISP_LOG_BATTERY_LEVEL_EVENT
	bool "Log battery level events"
	default y
	help
	  Log battery level events.

config ISP_LOG_MOTION_ACCEL_EVENT
	bool "Log accelerometer events"
	default y
	help
	  Log accelerometer events.

endmenu

endif
```

## src/modules/Kconfig
```kconfig
#
# Copyright (c) 2018 Nordic Semiconductor
#
# SPDX-License-Identifier: LicenseRef-Nordic-5-Clause
#

menu "Application modules"

rsource "Kconfig.twr"
rsource "Kconfig.ble_range_service"
rsource "Kconfig.battery_meas"
rsource "Kconfig.motion"
rsource "Kconfig.leds_ctrl"
rsource "Kconfig.watchdog"

endmenu
```

## src/modules/Kconfig.battery_meas
```kconfig
menu "Battery measurement configuration"

config ISP_BATTERY_MEAS
	bool "Enable battery measurement circuit"
	default n
	select ADC
	select ADC_ASYNC
	select ADC_NRFX_SAADC
	help
	  If selected, battery measurement is enabled.

config ISP_BATTERY_MEAS_MIN_LEVEL
	int "Minimum battery voltage [mV] that corresponds to 0% level"
	depends on ISP_BATTERY_MEAS
	default 2100
	help
	  This option specifies battery voltage [mV] that corresponds to 0% battery level.

config ISP_BATTERY_MEAS_MAX_LEVEL
	int "Maximum battery voltage [mV] that corresponds to 100% level"
	depends on ISP_BATTERY_MEAS
	default 3000
	help
	  This option specifies battery voltage [mV] that corresponds to 100% battery level.

config ISP_BATTERY_MEAS_HAS_VOLTAGE_DIVIDER
	bool "Use voltage divider for battery measurement"
	depends on ISP_BATTERY_MEAS
	help
	  Enable if voltage divider is used for battery measurement.

config ISP_BATTERY_MEAS_VOLTAGE_DIVIDER_UPPER
	int "Upper resistor in battery measurement voltage divider [kOhm]"
	depends on ISP_BATTERY_MEAS_HAS_VOLTAGE_DIVIDER
	help
	  Upper resistor value [kOhm]. Output voltage is measured on the lower resistor.

config ISP_BATTERY_MEAS_VOLTAGE_DIVIDER_LOWER
	int "Lower resistor in battery measurement voltage divider [kOhm]"
	depends on ISP_BATTERY_MEAS_HAS_VOLTAGE_DIVIDER
	help
	  Lower resistor value [kOhm]. Output voltage is measured on the lower resistor.

config ISP_BATTERY_MEAS_POLL_INTERVAL_MS
	int "Time between the subsequent battery measurements [ms]"
	depends on ISP_BATTERY_MEAS
	default 60000
	range 500 120000
	help
	  Time interval between the subsequent battery measurements [ms].

if ISP_BATTERY_MEAS
module = ISP_BATTERY_MEAS
module-str = battery measurement module
source "subsys/logging/Kconfig.template.log_config"
endif

endmenu
```

## src/modules/Kconfig.ble_range_service
```kconfig
menu "BLE Range Service"

config ISP_BLE_RANGE_SERVICE
	bool "Enable BLE Range Sevice"
	depends on BT_PERIPHERAL
	help
	  This option enables GATT Range Service application
	  module.

endmenu
```

## src/modules/Kconfig.leds_ctrl
```kconfig
menu "LEDS"

config ISP_LEDS_CTRL
	bool "Enable LEDS control"
	help
	  This option enables LEDS control.

module = ISP_LED_CTRL
module-str = LED control
source "subsys/logging/Kconfig.template.log_config"

endmenu
```

## src/modules/Kconfig.motion
```kconfig
menu "Motion"

config ISP_MOTION
	bool "Enable motion module"
	help
	  This option enables accelerometer.


if ISP_MOTION

module = ISP_MOTION
module-str = motion
source "subsys/logging/Kconfig.template.log_config"

endif

endmenu
```

## src/modules/Kconfig.twr
```kconfig
menu "Two-Way Ranging"

config ISP_TWR
	bool "Enable Two-Way Ranging"
	help
	  This option enables two-way ranging operations using UWB technology.

choice ISP_TWR_ROLE
	bool "Select TWR role"
	default ISP_TWR_INITIATOR
	help
	  This option let you choose wich TWR role to use.

config ISP_TWR_INITIATOR
	bool "Set TWR role as initiator"

config ISP_TWR_RESPONDER
	bool "Set TWR role as responder"
endchoice

config ISP_TWR_FRAME_FILTERING
	bool "Enable frame filtering for Two-Way Ranging"
	help
	  This option enables frame filtering for two-way ranging operations.
endmenu
```
